## components/platform/Kconfig
```kconfig
menu "RecLink board"

    config BRIDGE_UART_PORT
        int "FC MSP UART port number"
        default 1
        range 0 2
        help
            UART peripheral wired to the flight controller's MSP port.
            Must be a non-inverted UART (spec 1.3). On the SuperMini
            prototype, UART1; on the final RecLink board, UART0 (its native
            pins share boot-log traffic with the FC link -- see the TODO on
            silencing the bootloader log).

    config BRIDGE_UART_TX_GPIO
        int "FC MSP UART TX GPIO (ESP -> FC RX)"
        default 5

    config BRIDGE_UART_RX_GPIO
        int "FC MSP UART RX GPIO (FC TX -> ESP)"
        default 4

    config BRIDGE_BUTTON_GPIO
        int "Button GPIO (BOOT/GPIO0 acceptable)"
        default 9
        help
            Short press = identify. Long press (>=3 s), while running,
            toggles the config portal. Held 10 s, while running, = factory
            reset (spec 2.3 / 11.0). Runtime-only, deliberately -- this pin
            doubles as the ROM download-mode strap on ESP32-C3/S3, so it is
            never sampled at boot (a held button at power-up would risk
            entering the ROM bootloader instead of running firmware).

    config BRIDGE_BUTTON_ACTIVE_LOW
        bool "Button is active-low"
        default y

    choice BRIDGE_LED_KIND
        prompt "Status LED type"
        default BRIDGE_LED_WS2812
        config BRIDGE_LED_WS2812
            bool "Addressable WS2812 (single pixel)"
        config BRIDGE_LED_GPIO
            bool "Plain GPIO LED"
    endchoice

    config BRIDGE_LED_GPIO_NUM
        int "Status LED GPIO"
        default 8

    config BRIDGE_LED_ACTIVE_LOW
        bool "Plain LED is active-low"
        depends on BRIDGE_LED_GPIO
        default y

endmenu
```

## gopro_ble_debug/main/Kconfig.projbuild
```kconfig
menu "GOPRO-BLE-DEBUG"

config DBG_AP_SSID_PREFIX
    string "Wi-Fi AP SSID prefix"
    default "RECLINK-DBG"
    help
        The AP is named <prefix>-XXXX (last two MAC bytes), distinct from the
        original firmware's RECLINK-XXXX so you can tell which image is running.

config DBG_AP_PASSWORD
    string "Wi-Fi AP password (>= 8 chars, empty = open)"
    default "reclinkfpv"

config DBG_AP_CHANNEL
    int "Wi-Fi AP channel"
    range 1 13
    default 1

config DBG_LED_GPIO
    int "Status LED GPIO (-1 = none)"
    range -1 48
    default -1

config DBG_LED_ACTIVE_LOW
    bool "Status LED is active-low"
    default n

endmenu
```
